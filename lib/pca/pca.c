/********************************Copyright (c)**********************************\
**
**                   (c) Copyright 2019, Main, China, QD.
**                           All Rights Reserved
**
**                                 By(wo4fisher)
**                           http://www.wo4fisher.com
**
**----------------------------------文件信息------------------------------------
** 文件名称: pca.c
** 创建人员: wht
** 创建日期: 2019-02-20
** 文档描述: pca实现led渐变灯
**
**----------------------------------版本信息------------------------------------
** 版本代号: V0.1
** 版本说明: 初始版本
**
**------------------------------------------------------------------------------
\********************************End of Head************************************/

#include  "pca.h"

/*******************************************************************************
** 函数名称: pca_init
** 功能描述:
** 参数说明: None
** 返回说明: None
** 创建人员: wht
** 创建日期: 2019-02-20
**------------------------------------------------------------------------------
** 修改人员:wht
** 修改日期:
** 修改描述:
**------------------------------------------------------------------------------
********************************************************************************/
void pca_init(void)
{
    PCA_USE_P24P25P26P27();//输出引脚选择
    CCON = 0;  //初始化PCA控制寄存器
    //PCA定时器停止
    //清除CF标志
    //清除模块中断标志
    CL = 0;          //复位PCA寄存器
    CH = 0;
    CMOD = 0x02;     //设置PCA时钟源

    //PCA0 set mode
    PCA0_PWM(8);    //PCA模块1工作于8位PWM
    PCA0_PWM_rise_int(8);//PCA模块1为8位PWM模式
    CCAP0H = CCAP0L = 0x02;  //PWM1的占空比为75% ((80H-20H)/80H)   //禁止PCA定时器溢出中断
    //PCA1 set mode
    PCA1_PWM(8);    //PCA模块1工作于8位PWM
    PCA1_PWM_rise_int(8);//PCA模块1为8位PWM模式
    CCAP1H = CCAP1L = 0x02;  //PWM1的占空比为75% ((80H-20H)/80H)

    PCA_START();
}
/*******************************************************************************
** 函数名称: pca_dinit
** 功能描述:
** 参数说明: None
** 返回说明: None
** 创建人员: wht
** 创建日期: 2019-02-20
**------------------------------------------------------------------------------
** 修改人员:wht
** 修改日期:
** 修改描述:
**------------------------------------------------------------------------------
********************************************************************************/
void pca_dinit(void)
{
    PCA_STOP();
    PCA0_none() ;
    PCA1_none();
}

/*******************************************************************************
** 函数名称: pca_demo
** 功能描述:
** 参数说明: None
** 返回说明: None
** 创建人员: wht
** 创建日期: 2019-02-20
**------------------------------------------------------------------------------
** 修改人员:wht
** 修改日期:
** 修改描述:
**------------------------------------------------------------------------------
********************************************************************************/
void pca_demo(void)
{
    static uint16 xdata count=0;
    switch(count)
    {
    case 0:
        if(CCAP0H++ >= 0x75)count=1;
        break;
    case 1:
        if(CCAP0H-- <= 0x01)count=2;
        break;
    case 2:
        if(CCAP1H++ >= 0x75)count=3;
        break;
    case 3:
        if(CCAP1H-- <= 0x05)count=1;
        break;
    default:
        break;
    }
}

/********************************End of File************************************/
